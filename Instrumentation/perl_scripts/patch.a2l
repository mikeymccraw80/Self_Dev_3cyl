/* * old first * // */ /begin\s+MOD_PAR
/* * old last * // */ /end\s+IF_DATA
/* * new begin * // */
/begin MOD_PAR "MONACO" VERSION "NA" CUSTOMER_NO "DELPHID" USER "Your Name" PHONE_NO "0086-21-28967584" CPU_TYPE "MPC5634M" ECU "MT22.3 EDU"
 /begin MEMORY_SEGMENT Code "External Flash Code Space" CODE FLASH INTERN 0x00040000 0x00140000 -1 -1 -1 -1 -1 /end MEMORY_SEGMENT
 /begin MEMORY_SEGMENT Code "External Flash Calibration Space Pattern and Sum" RESERVED FLASH INTERN 0x00020000 0x00000004 -1 -1 -1 -1 -1 /end MEMORY_SEGMENT
 /begin MEMORY_SEGMENT Code "External Flash Calibration Space" DATA FLASH INTERN 0x00020004 0x0001FFF8 -1 -1 -1 -1 -1 /end MEMORY_SEGMENT
 /begin MEMORY_SEGMENT Code "External Flash Calibration Space - CAL form ID and Pattern" RESERVED FLASH INTERN 0x0003FFFC 0x00000004 -1 -1 -1 -1 -1 /end MEMORY_SEGMENT
 /begin MEMORY_SEGMENT Data "External RAM Calibration Space - Pattern and Sum" RESERVED RAM EXTERN 0x40010000 0x00000004 -1 -1 -1 -1 -1 /end MEMORY_SEGMENT
 /begin MEMORY_SEGMENT Data "External RAM Calibration Space" DATA RAM EXTERN 0x40010004 0x0001FFF8 -1 -1 -1 -1 -1 /end MEMORY_SEGMENT
 /begin MEMORY_SEGMENT Data "External RAM Calibration Space - CAL form ID and Pattern" RESERVED RAM EXTERN 0x4002FFFC 0x00000004 -1 -1 -1 -1 -1 /end MEMORY_SEGMENT
 /begin MEMORY_SEGMENT Ram "External Ram Space" VARIABLES RAM EXTERN 0x40000000 0x00016FFF -1 -1 -1 -1 -1 /end MEMORY_SEGMENT
 /begin MEMORY_SEGMENT Code "External Flash eCalibration Space Pattern and Sum" RESERVED FLASH INTERN 0x00010000 0x00000004 -1 -1 -1 -1 -1 /end MEMORY_SEGMENT
 /begin MEMORY_SEGMENT OFFLINE_DATA "External Flash eCalibration Space" OFFLINE_DATA FLASH INTERN 0x00010004 0x00007FF8 -1 -1 -1 -1 -1 /end MEMORY_SEGMENT
 /begin MEMORY_SEGMENT Code "External Flash eCalibration Space - CAL form ID and Pattern" RESERVED FLASH INTERN 0x00017FFC 0x00000004 -1 -1 -1 -1 -1 /end MEMORY_SEGMENT
 /begin MEMORY_SEGMENT Code "External Flash eCalibration Space Pattern and Sum" RESERVED FLASH INTERN 0x00010000 0x00000004 -1 -1 -1 -1 -1 /end MEMORY_SEGMENT
 /begin MEMORY_SEGMENT Code "External Flash eCalibration Space - CAL form ID and Pattern" RESERVED FLASH INTERN 0x00010004 0x00007FFC -1 -1 -1 -1 -1 /end MEMORY_SEGMENT
/end MOD_PAR
/begin MOD_COMMON "" BYTE_ORDER MSB_FIRST ALIGNMENT_LONG 2 ALIGNMENT_WORD 1 /end MOD_COMMON
/begin IF_DATA ASAP1B_CCP /* Specific definition for CCP */
 /begin SOURCE "500ms" 3 /* Scaling Unit: 3 = 1 ms */ 125 /* Rate in Scaling Unit: 500 */ /* Refresh rate = 1 * 500 ms = 500ms */ DISPLAY_IDENTIFIER DAQ3
  /begin QP_BLOB 3 LENGTH 0x3A CAN_ID_FIXED 0x7D8 RASTER 25 REDUCTION_ALLOWED FIRST_PID 0x3C /end QP_BLOB
 /end SOURCE
 /begin SOURCE "10ms" 1 1000 /* Rate in Scaling Unit: 782 */ /* Refresh rate = 1000 * 10 us = 10ms */ DISPLAY_IDENTIFIER DAQ1
  /begin QP_BLOB 1 LENGTH 0x14 CAN_ID_FIXED 0x7D6 RASTER 10 REDUCTION_ALLOWED FIRST_PID 0x14 /end QP_BLOB
 /end SOURCE
 /begin SOURCE "50ms" 1 1562 /* Rate in Scaling Unit: 5000 */ /* Refresh rate = 5000 * 10us = 50ms */ DISPLAY_IDENTIFIER DAQ2
  /begin QP_BLOB 2 LENGTH 0x14 CAN_ID_FIXED 0x7D7 RASTER 11 REDUCTION_ALLOWED FIRST_PID 0x28 /end QP_BLOB
 /end SOURCE
 /begin SOURCE "Cyl Event" 103 /* Scaling Unit: 103 = cylinder segment */ 1 /* Rate in Scaling Unit: 1 */ /* Refresh rate = */ /* every cylinder combustion */ DISPLAY_IDENTIFIER DAQ0
  /begin QP_BLOB 0 LENGTH 0x14 CAN_ID_FIXED 0x7D5 RASTER 0 REDUCTION_ALLOWED FIRST_PID 0x00 /end QP_BLOB
 /end SOURCE
 /begin RASTER "Cyl Event Trigger" "Cyl" 0 103 /* Scaling Unit: 103 = cylinder segment */ 1 /* Rate in Scaling Unit: 1 */ /* Refresh rate = */ /* every cylinder combustion */ /end RASTER
 /begin RASTER "10ms Trigger" "10" 10 1 1000 /* Rate in Scaling Unit: 1000 */ /* Refresh rate = 1000 * 10 us = 10ms */ /end RASTER
 /begin RASTER "50ms Trigger" "50" 11 1 5000 /* Rate in Scaling Unit: 5000 */ /* Refresh rate = 5000 * 10us = 50ms */ /end RASTER
 /begin RASTER "500ms Trigger" "500" 25 3 /* Scaling Unit: 3 = 1 ms */ 125 /* Rate in Scaling Unit: 125 */ /* Refresh rate = 1 * 500 ms = 500ms */ /end RASTER
 /begin SEED_KEY "" "" "" /end SEED_KEY
 /begin TP_BLOB 0x0201 /* CCP Version, High Byte: Version
Low Byte : subversion (dec.) */ 0x0202 /* Blob-Version, High Byte: Version
Low Byte : subversion (dec.) */ 0x7D0 /* CAN-Message ID for 'Transmitting to ECU (CRM)'
Bit31 = 1: extended Identifier
Bit31 = 0: standard Identifier */ 0x7D4 /* CAN-Message ID for 'Receiving from ECU (DTM)'
Bit31 = 1: extended Identifier
Bit31 = 0: standard Identifier */ 0x0000 /* Logical CCP-Address of the (station address) */ 1 /* Byte order of Multiple-byte-items
1 = high Byte first, 2 = low byte first */ BAUDRATE 250000 SAMPLE_POINT 70 SAMPLE_RATE 1 BTL_CYCLES 16 SJW 2 SYNC_EDGE 0 DAQ_MODE 1 /* 1 = one DAQ per cycle */ CONSISTENCY 1 /* 1 = ODT consistant */ ADDRESS_EXTENSION 0 /* 0 = 1 extension per DAQ (not supported) */ RESUME_SUPPORTED /* necessary for ResumeBit support */ /* STORE_SUPPORTED */ /* Not supported */
  /begin CHECKSUM_PARAM 0x8001 /* checksum calculation procedure
standard types not yet defined,
if greater of equal 1000 : manufacturer specific */ 0x3FFF /* Maximum block length used by an ASAP1a-CCP
command, for checksum calculation procedure */ CHECKSUM_CALCULATION ACTIVE_PAGE /end CHECKSUM_PARAM
  /begin DEFINED_PAGES 1 "Working page" 0 0x40010000 0x20000 /* To maintian one A2L file the start address of working page is defined as andorra configruation */ RAM /* this will be converted according to the actual type of instrumentation. */ RAM_INIT_BY_ECU DEFAULT /end DEFINED_PAGES
  /begin DEFINED_PAGES 2 "Reference page" 0 0x00020000 0x20000 FLASH DEFAULT /end DEFINED_PAGES
  OPTIONAL_CMD 0x0C /* SET_S_STATUS */ OPTIONAL_CMD 0x0D /* GET_S_STATUS */ OPTIONAL_CMD 0x0E /* Build Checksum */ OPTIONAL_CMD 0x11 /* SelectCal page */ OPTIONAL_CMD 0x19 /* Move */ /end TP_BLOB
/end IF_DATA
/* * new end * // */
