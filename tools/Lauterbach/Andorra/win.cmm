// T32-3 Sat Feb 12 13:41:57 2005

 B::
 
 TOOLBAR ON
 STATUSBAR ON
 WINPAGE.RESET
 
 WINCLEAR
 WINPOS 0.0 31.5 88. 18. 0. 0. W004
 Register
 
 WINPOS 91.5 0.125 66. 6. 13. 1. W000
 data.dump e:0x40000000 /DIALOG /LONG
 
 WINPOS 91.125 33.0 77. 13. 0. 0. W009
 Var.Watch    %location %spotlight %e
 
 VAR.ADDWATCH KtTRVC_AXIS_TransOilTempLkUp
 VAR.ADDWATCH KtTRVC_AXIS_TransOilTempMap
 VAR.ADDWATCH KtTRVC_T_TransOilTempMap
 VAR.ADDWATCH KbTRVC_UseGM_TransOilTemperature
 VAR.ADDWATCH KcTRVC_Cnt_TransOilTmpJumpEnblThrsh
 VAR.ADDWATCH VfTRVC_T_TransOilTempRaw
 VAR.ADDWATCH T_TransOil
 VAR.ADDWATCH VfTRVC_T_TransOilTempAD
 VAR.ADDWATCH T_Substrate
 VAR.ADDWATCH T_Powerup
 VAR.ADDWATCH T_Transoil_Max_Cnt
 VAR.ADDWATCH T_Transoil_Min_Cnt
 VAR.ADDWATCH T_Substrate_Open_Ckt_Cnt
 VAR.ADDWATCH  T_Substrate_Short_Ckt_Cnt
 VAR.ADDWATCH T_Powerup_Open_Ckt_Cnt
 VAR.ADDWATCH T_Powerup_Short_Ckt_Cnt
 VAR.ADDWATCH HWIO_Periodic_Count
 VAR.ADDWATCH Tst_Test_Mode
 VAR.ADDWATCH Reset_Source
 
 WINPOS 91.0 11.125 66. 6. 13. 1. W007
 data.dump e:0x001c0000 /DIALOG /LONG
 
 WINPOS 90.75 22.0 66. 6. 13. 1. W006
 data.dump e:0x20000000 /DIALOG /LONG
 
 WINPOS 0.0 0.0 88. 27. 13. 1. W000
 WINTABS 10. 17. 25. 62.
 Data.List
 
 WINPAGE.SELECT P000     
 
 ENDDO
