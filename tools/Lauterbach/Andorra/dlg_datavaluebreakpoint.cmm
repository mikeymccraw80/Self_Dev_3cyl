;*===========================================================================*
; FILE: %name:  dlg_datavaluebreakpoint.cmm %
; %version:           1 % 
; %date_modified:      % 
; %derived_by:        rz65p6 % 
; Copyright 2009 Delphi Technologies, Inc., All Rights Reserved. 
;*===========================================================================*
 
;*===========================================================================*
;                        datavaluebreak.cmm
; Description 
; ----------- 
;   This file follows the Stephan Lauterbach example to program a breakpoint
;   on a Data Write of a specific value. Stephan says this method is used 
;   because (his words);
;   "Unfortunately the MPC555x has no data value breakpoints. The only way to
;    do this is currently to use the complex trigger unit (Analyzer.Program
;    command). In the near future we will also allow to stop the target 
;    without using the A.P command". 
;
;  REPLACE "var1" in 2 places with the variable name of your choice, and adjust
;  the Data size and value as needed in 1 place below. 
;   
;  v0 Feb-14-2005  J. Siitari -- original version 
;  v1 Feb-24-2005  J. Siitari -- modified to add analyzer FIFO mode setting
;*===========================================================================*
;accept value from datavaluebreak dialog.

LOCAL &brksymbol
LOCAL &brkvalue
&brksymbol="ms1000_counter"
&brkvalue=0x01

;Turn on Branch tracing, and turn off tracing of all Data 
;Selective Data Tracing will get turned on in next B.S cmd
IF POWERNEXUS()
(
   SYS.OPTION BTM ON
   SYS.OPTION DTM OFF
)
;Must set Nexus Analyzer to FIFO mode, so trace is still being captured
;(and monitored for desired event) when desired Data Write occurs. 
IF POWERNEXUS()
(
   A.MODE FIFO
)
WINPOS ,,,,,, _a_dialog

DIALOG
(
   HEADER "Data Value Breakpoint"
   
   

   POS 1. 1. 34. 3.
   BOX "Address/Symbol"
   POS 2. 2. 25. 1.
   BRKPNTSYM: EDIT "" "GOSUB SetBreakSymbol"

   POS 30. 2. 3. 1.
   BUTTON "[:symbols]" 
   (
         local &wildcard
         &wildcard=DIALOG.STRING(BRKPNTSYM)
         if "&wildcard"==""
           &wildcard="*"
         if !STRING.FIND("&wildcard","*?")
           &wildcard="*&wildcard*"
         SYMBOL.BROWSE &wildcard /c "DIALOG.SET BRKPNTSYM ""*""" /d
      ENDDO
   )

   POS 1. 4. 24. 3.
   BOX "DATA"
   POS 2. 5. 10. 1.
   BRKPNTVAL: EDIT "" 
    (
     GOSUB SetBreakValue
     ENDDO
    )
   POS 13. 5. 10. 1.
   BRKPNTSIZE: PULLDOWN "Byte,Word,Long" ""


   POS 14. 7. 10. 1.
   BUTTON " OK " 
    (
     GOSUB SetBreakPoint
     ENDDO
    )

   POS 25. 7. 10. 1.
   BUTTON " Cancel " 
   (
      DIALOG.END
   )
   
)

DIALOG.SET BRKPNTVAL "&brkvalue"
DIALOG.SET BRKPNTSYM "&brksymbol"

STOP

SetBreakSymbol:
IF DIALOG.STRING(BRKPNTSYM)!=""
(
   &brksymbol=DIALOG.STRING(BRKPNTSYM)
)
ELSE
(
   PRINT "Nothing to set!!"
)
RETURN

SetBreakValue:
IF DIALOG.STRING(BRKPNTVAL)!=""
(
   &brkvalue=DIALOG.STRING(BRKPNTVAL)
)
ELSE
(
   PRINT "No Value Entered!!"
)
RETURN

SetBreakPoint:
LOCAL &result

DIALOG.YESNO "This will erase your current breakpoints, continue?"
ENTRY &result
IF !(&result)
(
 RETURN
)

;clear any breakpoints that are of the type we are going to set.
IF POWERNEXUS()
(
   BREAK.DELETE /ALPHA /HARD
   BREAK.DELETE /TRACEDATA /ONCHIP
   ;set up selective Data tracing so we get var1 trace messages along with the 
   ;Branch trace messages. Can't turn on tracing of all Data, as that usually
   ;causes too many Overflow errors due to Nexus FIFO buffer overrun.
   BREAK.SET &brksymbol++0x3 /TraceData
)

;set breakpoint and equate to Alpha label for ref by Analyzer  
IF DIALOG.STRING(BRKPNTSIZE)=="Byte"
(
   IF POWERNEXUS()
   (
      BREAK.SET &brksymbol++0x3 /ALPHA /HARD /WRITE /DATA.LONG &brkvalue
   )
)
ELSE IF DIALOG.STRING(BRKPNTSIZE)=="Word"
(
   IF POWERNEXUS()
   (
      BREAK.SET &brksymbol++0x2 /ALPHA /HARD /WRITE /DATA.LONG &brkvalue
   )
)
ELSE
(
   IF POWERNEXUS()
   (
      BREAK.SET &brksymbol /ALPHA /HARD /WRITE /DATA.LONG &brkvalue
   )
)

IF POWERNEXUS()
(
  ;program Analyzer to respond to Alpha event, and break on it
  A.REPROGRAM
  (
    BREAK.PROGRAM IF alphabreak
  )
)

;end macro script file
RETURN
     
ENDDO 


;*===========================================================================*
;* File Revision History (top to bottom: first revision to last revision)
;*===========================================================================
;*
;* Date        userid    (Description on following lines: SCR #, etc.)
;* ----------- --------
;* 12-MAY-2005 jzcpfk (JWH2)
;* + Task#37021 SCR - 4003
;* + Initial creation
;*
;* 13-SEP-2006 zzyl53 (TWK)
;* + Task#45144 SCR - 4854
;*   + Added check for POWERNEXUS connectivity so that certain Nexus
;*     commands are not used if JTAG debugger is connected (instead of
;*     LA-7610 Nexus probe).
;*
;* 29-SEP-2006 zzyl53 (TWK)
;* + Task#45473 SCR-4854
;*   + Move check for POWERNEXUS above A.REPROGRAM. This was preventing the
;*     trigger from being programed.
;*===========================================================================*